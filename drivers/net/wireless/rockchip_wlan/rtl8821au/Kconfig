## drivers/net/wireless/rockchip_wlan/rtl8821au/Kconfig
```kconfig
config RTL8821AU
	tristate "Realtek 8821A USB WiFi"
	depends on USB
		select WIRELESS_EXT
		select WEXT_PRIV
		select IEEE80211
		select BT_RTKBTUSB
		select UHID
	---help---
	  Help message of RTL8821AU
```
